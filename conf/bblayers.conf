## conf/bblayers.conf
```bitbake
LCONF_VERSION = "7"

BBPATH = "${TOPDIR}"

BBLAYERS := " \
    ${TOPDIR}/layers/meta-coward-kr260 \
    ${TOPDIR}/layers/openembedded-core/meta \
    ${TOPDIR}/layers/meta-arm/meta-arm \
    ${TOPDIR}/layers/meta-arm/meta-arm-toolchain \
    ${TOPDIR}/layers/meta-openembedded/meta-perl \
    ${TOPDIR}/layers/meta-openembedded/meta-python \
    ${TOPDIR}/layers/meta-openembedded/meta-filesystems \
    ${TOPDIR}/layers/meta-openembedded/meta-gnome \
    ${TOPDIR}/layers/meta-openembedded/meta-multimedia \
    ${TOPDIR}/layers/meta-openembedded/meta-networking \
    ${TOPDIR}/layers/meta-openembedded/meta-webserver \
    ${TOPDIR}/layers/meta-openembedded/meta-xfce \
    ${TOPDIR}/layers/meta-openembedded/meta-initramfs \
    ${TOPDIR}/layers/meta-openembedded/meta-oe \
    ${TOPDIR}/layers/meta-clang \
    ${TOPDIR}/layers/meta-qt5 \
    ${TOPDIR}/layers/meta-xilinx/meta-microblaze \
    ${TOPDIR}/layers/meta-xilinx/meta-xilinx-core \
    ${TOPDIR}/layers/meta-xilinx/meta-xilinx-bsp \
    ${TOPDIR}/layers/meta-xilinx/meta-xilinx-contrib \
    ${TOPDIR}/layers/meta-xilinx/meta-xilinx-standalone \
    ${TOPDIR}/layers/meta-xilinx/meta-xilinx-vendor \
    ${TOPDIR}/layers/meta-xilinx-tools \
    ${TOPDIR}/layers/meta-kria \
    ${TOPDIR}/layers/meta-petalinux \
    ${TOPDIR}/layers/meta-virtualization \
    ${TOPDIR}/layers/meta-openamp \
    ${TOPDIR}/layers/meta-jupyter \
    ${TOPDIR}/layers/meta-vitis \
    ${TOPDIR}/layers/meta-xilinx-tsn \
    ${TOPDIR}/layers/meta-ros/meta-ros-common \
    ${TOPDIR}/layers/meta-ros/meta-ros2 \
    ${TOPDIR}/layers/meta-ros/meta-ros2-humble \
    ${TOPDIR}/layers/wrlinux \
    ${TOPDIR}/layers/wrlinux/wrlinux-distro \
    ${TOPDIR}/layers/wr-template \
    "
```

## conf/local.conf
```bitbake
MACHINE = "coward-kr260"

# Uncomment the following line to use a custom XSA, add path and sha256sum of your custom XSA
# COWARD_XSA_PATH = "file://<custom_path>"
# COWARD_XSA_SHA256 = "<sha256sum of custom xsa>"

# When building wrlinux distro must set initramfs image to wrlinux-image-initramfs
DISTRO = "wrlinux"
INITRAMFS_IMAGE = "wrlinux-image-initramfs"

# default settings required for xilinx builds
XILINX_WITH_ESW = "xsct"
LICENSE_FLAGS_ACCEPTED += "xilinx"
```

## layers/meta-coward-kr260/conf/layer.conf
```bitbake
# We have a conf and classes directory, add to BBPATH
BBPATH .= ":${LAYERDIR}"

# We have recipes-* directories, add to BBFILES
BBFILES += "${LAYERDIR}/recipes-*/*/*.bb ${LAYERDIR}/recipes-*/*/*.bbappend"

BBFILE_COLLECTIONS += "coward-kr260"
BBFILE_PATTERN_coward-kr260 = "^${LAYERDIR}/"
BBFILE_PRIORITY_coward-kr260 = "1"

# This should only be incremented on significant changes that will
# cause compatibility issues with other layers
LAYERVERSION_coward-kr260 = "1"

LAYERDEPENDS_coward-kr260 = "core"

LAYERSERIES_COMPAT_coward-kr260 = "scarthgap"
```

## layers/meta-coward-kr260/conf/machine/coward-kr260.conf
```bitbake
#@TYPE: Machine
#@NAME: Specific Kria KR260 Robotics Starter Kit of mine
#@DESCRIPTION: Machine configuration for Kria KR260 Robotics Starter Kit (Kria K26 SOM + KR260 carrier board).

#### Preamble
MACHINEOVERRIDES =. "${@['', 'coward-kr260:']['coward-kr260' != '${MACHINE}']}"
MACHINEOVERRIDES =. "k26-kr:"
#### Regular settings follow

require conf/machine/include/k26-smk.inc
require conf/machine/include/kria-qemu-kr.inc

INITRAMFS_IMAGE ?= "petalinux-initramfs-image"

# This is an 'XSCT' based BSP
XILINX_XSCT_VERSION = "2024.2"
XILINX_WITH_ESW = "xsct"

COWARD_XSA_PATH ?= "file://kr260_plane_jane.xsa"
COWARD_XSA_SHA256 ?= "b36db3b3856502c3b275cafb58f53bdd591c2112c135dc2c0b9d3e8171406ecc"

# Add system XSA
HDF_URI = "${COWARD_XSA_PATH}"
HDF_URI[sha256sum] = "${COWARD_XSA_SHA256}"

UBOOT_DT_FILES = "\
    zynqmp-sck-kr-g-revA.dtso \
    zynqmp-sck-kr-g-revB.dtso \
    "

# DTB_FILE_NAME cant be changed globally or it will break the build but we can modify it for these
# tasks specifically so that the resulting symlink points to the correct file for a specific board
DTB_FILE_NAME:task-install:pn-device-tree = "${UBOOT_DTFILE_PREFIX}-zynqmp-sck-kr-g-revB.dtb"
DTB_FILE_NAME:task-deploy:pn-device-tree = "${UBOOT_DTFILE_PREFIX}-zynqmp-sck-kr-g-revB.dtb"
# Workaround for bitbake not detecting the above change in the hash
PR:append:pn-device-tree = ".1"

# Use custom name for xilinx-bootbin, because it is removed for kria soms in a xilinx inc.
# also add virtual/bitstream to the image depends so that is extracted as well
EXTRA_IMAGEDEPENDS += "virtual/bootbin virtual/bitstream"

# Kernel Configuration
PREFERRED_PROVIDER_virtual/kernel = "linux-xlnx"

#### No additional settings should be after the Postamble
#### Postamble
PACKAGE_EXTRA_ARCHS:append = "${@['', ' coward_kr260']['coward-kr260' != "${MACHINE}"]}"
```
